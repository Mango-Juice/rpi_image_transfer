/dts-v1/;
/plugin/;

/ {
    compatible = "brcm,bcm2711";

    fragment@0 {
        target-path = "/";
        __overlay__ {
            epaper_tx: epaper_tx_device {
                compatible = "epaper,gpio-tx";
                clock-gpios = <&gpio 13 0>;
                data-gpios = <&gpio 5 0>;
                start-stop-gpios = <&gpio 6 0>;
                ack-gpios = <&gpio 16 0>;
                nack-gpios = <&gpio 12 0>;
                status = "okay";
            };
        };
    };

    fragment@1 {
        target-path = "/";
        __overlay__ {
            epaper_rx: epaper_rx_device {
                compatible = "epaper,gpio-rx";
                clock-gpios = <&gpio 21 0>;
                data-gpios = <&gpio 19 0>;
                start-stop-gpios = <&gpio 26 0>;
                ack-gpios = <&gpio 25 0>;
                nack-gpios = <&gpio 20 0>;
                status = "okay";
            };
        };
    };
};